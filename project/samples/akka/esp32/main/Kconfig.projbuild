## project/samples/akka/esp32/main/Kconfig.projbuild
```kconfig
menu "AskBot device client"

    config ASKBOT_WIFI_SSID
        string "WiFi SSID"
        default "myssid"
        help
            Akka classic remoting is TCP, so this client needs IP connectivity.
            Unlike claude_hud_amoled (BLE only by design), AskBot talks over WiFi.

    config ASKBOT_WIFI_PASSWORD
        string "WiFi password"
        default "mypassword"

    config ASKBOT_HOST_IP
        string "AskBot.Host IP address"
        default "192.168.0.10"
        help
            Must match akka.remote.dot-netty.tcp.public-hostname on the host,
            i.e. what you pass as --host. 127.0.0.1 will not work from the board.

    config ASKBOT_HOST_PORT
        int "AskBot.Host port"
        default 2552

    config ASKBOT_HOST_SYSTEM
        string "Host ActorSystem name"
        default "AskBot"

    config ASKBOT_ACTOR_PATH
        string "Actor path to ask"
        default "/user/ask"

    config ASKBOT_LOCAL_SYSTEM
        string "This device's ActorSystem name"
        default "askbot-device"

    config ASKBOT_LOCAL_PORT
        int "Port this device advertises"
        default 2553
        help
            Advertised only. Nothing connects to it while the host keeps
            akka.remote.use-passive-connections = on (the default), which is what
            lets the device get away with having no listening socket.

endmenu
```

## project/samples/claude_hud_amoled/components/brookesia_app_askbot/Kconfig.projbuild
```kconfig
# WiFi credentials are not here: they belong to the device, and the Settings app owns
# them (see components/brookesia_app_settings/Kconfig.projbuild).
menu "AskBot (Akka remoting app)"

    config ASKBOT_HOST_IP
        string "AskBot.Host IP address"
        default "192.168.0.10"
        help
            Must equal what the host advertises (its --host argument, i.e.
            akka.remote.dot-netty.tcp.public-hostname). 127.0.0.1 cannot work here.

    config ASKBOT_HOST_PORT
        int "AskBot.Host port"
        default 2552

    config ASKBOT_HOST_SYSTEM
        string "Host ActorSystem name"
        default "AskBot"

    config ASKBOT_LOCAL_SYSTEM
        string "This device's ActorSystem name"
        default "askbot-device"

    config ASKBOT_LOCAL_PORT
        int "Port this device advertises"
        default 2553
        help
            Advertised in the handshake only. Nothing dials it while the host keeps
            akka.remote.use-passive-connections = on (its default), which is what
            lets the device work without a listening socket.

    config ASKBOT_VOLUME
        int "Speaker volume for spoken answers (0-100)"
        default 70
        range 0 100
        help
            The host synthesises answers with SuperTonic and streams them as IMA ADPCM
            at 16 kHz. Only used when the answer mode is "Text + voice".

endmenu
```

## project/samples/claude_hud_amoled/sdkconfig.defaults
```kconfig
CONFIG_IDF_TARGET="esp32s3"
CONFIG_ESPTOOLPY_FLASHMODE_QIO=y
CONFIG_ESPTOOLPY_FLASHSIZE_32MB=y
CONFIG_PARTITION_TABLE_CUSTOM=y
CONFIG_COMPILER_OPTIMIZATION_PERF=y
CONFIG_SPIRAM=y
CONFIG_SPIRAM_MODE_OCT=y
CONFIG_SPIRAM_FETCH_INSTRUCTIONS=y
CONFIG_SPIRAM_RODATA=y
CONFIG_SPIRAM_SPEED_80M=y
CONFIG_SPIRAM_MALLOC_ALWAYSINTERNAL=4096
CONFIG_SPIRAM_MALLOC_RESERVE_INTERNAL=4096
CONFIG_ESP_DEFAULT_CPU_FREQ_MHZ_240=y
CONFIG_FREERTOS_HZ=1000
CONFIG_SPIRAM_XIP_FROM_PSRAM=y
CONFIG_ESP32S3_INSTRUCTION_CACHE_32KB=y
CONFIG_ESP32S3_DATA_CACHE_64KB=y
CONFIG_ESP32S3_DATA_CACHE_LINE_64B=y
CONFIG_LV_OS_FREERTOS=y
CONFIG_LV_USE_CLIB_MALLOC=y
CONFIG_LV_USE_CLIB_STRING=y
CONFIG_LV_USE_CLIB_SPRINTF=y
CONFIG_LV_DEF_REFR_PERIOD=15
CONFIG_LV_OBJ_STYLE_CACHE=y
CONFIG_LV_DRAW_SW_DRAW_UNIT_CNT=2
CONFIG_ESP_BROOKESIA_ENABLE_AI_FRAMEWORK=n
CONFIG_ESP_BROOKESIA_GUI_ENABLE_ANIM_PLAYER=n
CONFIG_ESP_BROOKESIA_ENABLE_SERVICES=n
CONFIG_ESP_BROOKESIA_SYSTEMS_ENABLE_SPEAKER=n
CONFIG_BOOST_MATH_ENABLED=n
CONFIG_BOOST_SERIALIZATION_ENABLED=n
CONFIG_LV_USE_LOG=y
CONFIG_LV_LOG_PRINTF=y
CONFIG_LV_FONT_MONTSERRAT_8=y
CONFIG_LV_FONT_MONTSERRAT_10=y
CONFIG_LV_FONT_MONTSERRAT_12=y
CONFIG_LV_FONT_MONTSERRAT_16=y
CONFIG_LV_FONT_MONTSERRAT_18=y
CONFIG_LV_FONT_MONTSERRAT_20=y
CONFIG_LV_FONT_MONTSERRAT_22=y
CONFIG_LV_FONT_MONTSERRAT_24=y
CONFIG_LV_FONT_MONTSERRAT_26=y
CONFIG_LV_FONT_MONTSERRAT_28=y
CONFIG_LV_FONT_MONTSERRAT_30=y
CONFIG_LV_FONT_MONTSERRAT_32=y
CONFIG_LV_FONT_MONTSERRAT_34=y
CONFIG_LV_FONT_MONTSERRAT_36=y
CONFIG_LV_FONT_MONTSERRAT_38=y
CONFIG_LV_FONT_MONTSERRAT_40=y
CONFIG_LV_FONT_MONTSERRAT_42=y
CONFIG_LV_FONT_MONTSERRAT_44=y
CONFIG_LV_FONT_FMT_TXT_LARGE=y
CONFIG_LV_USE_FONT_COMPRESSED=y
CONFIG_LV_USE_SNAPSHOT=y
CONFIG_LV_BUILD_EXAMPLES=n

# ---- claude_hud additions ----
# Console on the native USB-Serial-JTAG (COM7) so `idf.py monitor` shows logs.
CONFIG_ESP_CONSOLE_USB_SERIAL_JTAG=y
CONFIG_PARTITION_TABLE_CUSTOM_FILENAME="partitions.csv"
# Bluetooth only: BLE (NimBLE) Nordic UART Service is the single transport.
CONFIG_BT_ENABLED=y
CONFIG_BT_NIMBLE_ENABLED=y
CONFIG_BT_BLUEDROID_ENABLED=n
CONFIG_BT_NIMBLE_MEM_ALLOC_MODE_EXTERNAL=y
CONFIG_BT_NIMBLE_ROLE_CENTRAL=n
CONFIG_BT_NIMBLE_ROLE_OBSERVER=n
CONFIG_BT_NIMBLE_MAX_CONNECTIONS=1
CONFIG_BT_NIMBLE_ATT_PREFERRED_MTU=512
# NimBLE logs every notify at INFO; audio streaming makes that unreadable.
CONFIG_BT_NIMBLE_LOG_LEVEL_WARNING=y

# Monospace 8x16 font for the CREW tile ASCII characters
CONFIG_LV_FONT_UNSCII_16=y
```
